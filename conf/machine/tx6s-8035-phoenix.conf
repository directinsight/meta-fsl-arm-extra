## conf/machine/tx6s-8035-phoenix.conf
```bitbake
#@TYPE: Machine
#@NAME: Direct Insight i.MX6S Triton TX6S Computer-On-Module
#@SOC: i.MX6S
#@DESCRIPTION: Machine configuration for Triton TX6S Computer-On-Module for Phoenix project
#@MAINTAINER: William White <william.white@directinsight.co.uk>

require include/tx6-karo-common.inc

SOC_FAMILY = "mx6:mx6dl:tx6"

KERNEL_DEVICETREE ?= "imx6dl-tx6s-8035-phoenix.dtb"

UBOOT_MACHINE = "tx6s-8035_config"

TXTYPE = "imx6s-tx6"
TXNVM = "emmc"
TXBASE_append = "-phoenix"
```

## conf/machine/tx6u-8030-txfb.conf
```bitbake
#@TYPE: Machine
#@NAME: Ka-Ro electronics i.MX6DL TX6DL Computer-On-Module
#@SOC: i.MX6DL
#@DESCRIPTION: Machine configuration for Ka-Ro electronics TX6DL Computer-On-Module
#@MAINTAINER: William White <william.white@directinsight.co.uk>

require include/tx6-di-common.inc

SOC_FAMILY = "mx6:mx6dl:tx6"

KERNEL_DEVICETREE ?= "imx6dl-tx6u-801x.dtb"

UBOOT_MACHINE = "tx6u-80x0_config"

TXTYPE = "imx6dl-tx6"
TXNVM = "nand"
TXBASE_append = "-txfb"
```
